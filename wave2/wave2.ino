/*
  

 Author: Allen Downey 
 
 Based on http://arduino.cc/en/Tutorial/AnalogInput
 Created by David Cuartielles
 modified 30 Aug 2011
 By Tom Igoe

 License: Public Domain
 
 */

#define maxWaveform 4
#define maxSamplesNum 120

static int waveformsTable[maxWaveform][maxSamplesNum] = {
  // Sin wave
  {
    0x7ff, 0x86a, 0x8d5, 0x93f, 0x9a9, 0xa11, 0xa78, 0xadd, 0xb40, 0xba1,
    0xbff, 0xc5a, 0xcb2, 0xd08, 0xd59, 0xda7, 0xdf1, 0xe36, 0xe77, 0xeb4,
    0xeec, 0xf1f, 0xf4d, 0xf77, 0xf9a, 0xfb9, 0xfd2, 0xfe5, 0xff3, 0xffc,
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    0x3ff, 0x45d, 0x4be, 0x521, 0x586, 0x5ed, 0x655, 0x6bf, 0x729, 0x794
  }
  ,

  // Triangular wave
  {
    0x44, 0x88, 0xcc, 0x110, 0x154, 0x198, 0x1dc, 0x220, 0x264, 0x2a8,
    0x2ec, 0x330, 0x374, 0x3b8, 0x3fc, 0x440, 0x484, 0x4c8, 0x50c, 0x550,
    0x594, 0x5d8, 0x61c, 0x660, 0x6a4, 0x6e8, 0x72c, 0x770, 0x7b4, 0x7f8,
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    0x264, 0x220, 0x1dc, 0x198, 0x154, 0x110, 0xcc, 0x88, 0x44, 0x0
  }
  ,

  // Sawtooth wave
  {
    0x22, 0x44, 0x66, 0x88, 0xaa, 0xcc, 0xee, 0x110, 0x132, 0x154,
    0x176, 0x198, 0x1ba, 0x1dc, 0x1fe, 0x220, 0x242, 0x264, 0x286, 0x2a8,
    0x2ca, 0x2ec, 0x30e, 0x330, 0x352, 0x374, 0x396, 0x3b8, 0x3da, 0x3fc,
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    0xebe, 0xee0, 0xf02, 0xf24, 0xf46, 0xf68, 0xf8a, 0xfac, 0xfce, 0xff0
  }
  ,

  // Square wave
  {
    0xfff, 0xfff, 0xfff, 0xfff, 0xfff, 0xfff, 0xfff, 0xfff, 0xfff, 0xfff,
    0xfff, 0xfff, 0xfff, 0xfff, 0xfff, 0xfff, 0xfff, 0xfff, 0xfff, 0xfff,
    0xfff, 0xfff, 0xfff, 0xfff, 0xfff, 0xfff, 0xfff, 0xfff, 0xfff, 0xfff,
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    0x0, 0x0, 0x0, 0x0, 0x0, 0x0, 0x0, 0x0, 0x0, 0x0
  }

};
 
 
int ledPin = 5;       // select the pin for the LED
int buttonPin1 = 2;
int buttonPin2 = 3;
int buttonPin3 = 4;
int pot = A0;

void setup() {
  Serial.begin(9600);

  pinMode(pot, INPUT);
  
  pinMode(buttonPin1, INPUT_PULLUP);  
  pinMode(buttonPin2, INPUT_PULLUP); 

  pinMode(buttonPin3, INPUT_PULLUP);

  pinMode(ledPin, OUTPUT);
  
  pinMode(13, OUTPUT);  
  pinMode(12, OUTPUT);  
  pinMode(11, OUTPUT);  
  pinMode(10, OUTPUT);  
  pinMode(9, OUTPUT);  
  pinMode(8, OUTPUT);  
  pinMode(7, OUTPUT);  
  pinMode(6, OUTPUT);  
}

void writeByte(int x) {
  int pin;
  
  for (pin=13; pin>=6; pin--) {
    digitalWrite(pin, x&1);
    x >>= 1;
  }
}

int counter = 0, delayCounter = 0, delayValue = 0;
unsigned long BASE_WAVELENGTH = 238;
int pitchShift = 0, BASE_DELAY_SHIFT = 50;
float delayGain = 3.0;
unsigned long SHIFT_FACTOR = 15;
int waveType = 1;
unsigned long lastButton = 0, lastDelay = 0;
unsigned long pitchDelay = 31, BUTTON_DEBOUNCE = 500, DELAY_DEBOUNCE = 500;
int button2State = LOW, button3State = LOW;


void loop() {
  int button1 = digitalRead(buttonPin1);
  int button2 = digitalRead(buttonPin3);
  int button3 = digitalRead(buttonPin2);

  if (micros() - lastButton >= BUTTON_DEBOUNCE) {
    lastButton = micros();
    if (button2 != button2State) {
      button2State = button2;

      if(button2State == HIGH) {
        waveType++;
        if (waveType >= maxWaveform) waveType = 0;
      }
    }
  }

  if(micros() - lastDelay >= DELAY_DEBOUNCE) {
    lastDelay = micros();
    if(!(button3) != button3State) {
      button3State = !(button3);
      if(button3State) {
        delayCounter = counter + BASE_DELAY_SHIFT;
        delayGain = 3;
      } else {
        delayValue = 0;
      }
    }

    if(button3State) {
      delayCounter++;
      delayGain += .1;
      delayValue = waveformsTable[waveType][delayCounter];
    }
  }
  
  pitchShift = analogRead(pot);
  if (button1) return;

  // write to the digital pins 
  pitchDelay = (SHIFT_FACTOR * pitchShift + BASE_WAVELENGTH)/maxSamplesNum;
  
  counter++;
  if (counter > maxSamplesNum) counter = 0;
  writeByte(waveformsTable[waveType][counter] + delayValue/delayGain);
  delayMicroseconds(pitchDelay);
}
